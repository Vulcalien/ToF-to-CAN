## apps/dds/Kconfig
```kconfig
#
# For a description of the syntax of this configuration file,
# see the file kconfig-language.txt in the NuttX tools repository.
#

config EUROBOT_DDS
	tristate "dds"
	default y
	---help---
		DDS application
```

## apps/receiver/Kconfig
```kconfig
#
# For a description of the syntax of this configuration file,
# see the file kconfig-language.txt in the NuttX tools repository.
#

config EUROBOT_RECEIVER
	tristate "CAN Receiver"
	default y
	depends on CAN
	---help---
		Data Receiver
```

## apps/sender/Kconfig
```kconfig
#
# For a description of the syntax of this configuration file,
# see the file kconfig-language.txt in the NuttX tools repository.
#

config EUROBOT_SENDER
	tristate "Sender"
	default y
	depends on CAN
	---help---
		Data Sender
```

## apps/tof/Kconfig
```kconfig
#
# For a description of the syntax of this configuration file,
# see the file kconfig-language.txt in the NuttX tools repository.
#

config EUROBOT_TOF
	tristate "Tof"
	default y
	---help---
		Time of flight application
```

## firmware/apps/tof/Kconfig
```kconfig
config CUSTOM_TOF_APP
    tristate "ToF App"
    default y
    ---help---
        ToF application
```

## tof-app/Kconfig
```kconfig
config TOF_APP
    tristate "ToF App"
    default y
    ---help---
        ToF application
```
